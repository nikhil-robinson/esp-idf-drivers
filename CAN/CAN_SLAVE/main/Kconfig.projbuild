## CAN/CAN_SLAVE/main/Kconfig.projbuild
```kconfig
menu "Example Configuration"

    config EXAMPLE_TX_GPIO_NUM
        int "TX GPIO number"
        default 21 if IDF_TARGET_ESP32
        default 43
        help
            This option selects the GPIO pin used for the TX signal. Connect the
            TX signal to your transceiver.

    config EXAMPLE_RX_GPIO_NUM
        int "RX GPIO number"
        default 22 if IDF_TARGET_ESP32
        default 44
        help
            This option selects the GPIO pin used for the RX signal. Connect the
            RX signal to your transceiver.

endmenu
```
